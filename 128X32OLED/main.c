/*
 * 128X32OLED.c
 *
 * Created: 7/31/2023 1:13:07 PM
 * Author : admin
 */ 

/*
 * LCD OLED.c
 *
 * Created: 7/27/2023 12:46:25 AM
 * Author : admin
 */ 
 #define __AVR_ATtiny24A__
#define F_CPU 8000000UL
#include <avr/io.h>
#include "I2C.h"
#include <util/delay.h>
#include <avr/pgmspace.h>

//#define OLED_ADDR       0x78                  // OLED write address
#define OLED_ADDR       0x7A                  // SIMULATION PROTEUS
#define OLED_CMD_MODE   0x00                  // set command mode
#define OLED_DAT_MODE   0x40                  // set data mode
#define OLED_INIT_LEN   12

const uint8_t OLED_INIT_CMD[] PROGMEM = {
	0xA8, 0x1F,       // set multiplex (HEIGHT-1): 0x1F for 128x32, 0x3F for 128x64
	0x22, 0x00, 0x03, // set min and max page
	0x20, 0x00,       // set horizontal memory addressing mode
	0xDA, 0x02,       // set COM pins hardware configuration to sequential
	0x8D, 0x14,       // enable charge pump
	0xAF,             // switch on OLED
	0xA1, 0xC8        // flip the screen
};

// standard ASCII 5x8 font (adapted from Neven Boyanov and Stephen Denne)
const uint8_t OLED_FONT1[] PROGMEM = {
	0x3E, 0x51, 0x49, 0x45, 0x3E, // 0 0
	0x00, 0x42, 0x7F, 0x40, 0x00, // 1 1
	0x42, 0x61, 0x51, 0x49, 0x46, // 2 2
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	0x00, 0x60, 0x60, 0x00, 0x00, // . 12
};

// standard ASCII 5x8 font (adapted from Neven Boyanov and Stephen Denne)
const uint8_t OLED_FONT[] PROGMEM = {
	0x00, 0x00, 0x00, 0x00, 0x00, //   0
	0x00, 0x00, 0x2f, 0x00, 0x00, // ! 1
	0x00, 0x07, 0x00, 0x07, 0x00, // " 2
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	0x40, 0x40, 0x40, 0x40, 0x40  // _ 63
};

// OLED init function
void OLED_init(void) {
	i2c_start();                     // initialize I2C first
	i2c_write(OLED_ADDR);                   // start transmission to OLED
	i2c_write(OLED_CMD_MODE);               // set command mode
	for (uint8_t i = 0; i < OLED_INIT_LEN; i++) i2c_write(pgm_read_byte(&OLED_INIT_CMD[i])); // send the command bytes
	i2c_stop();                             // stop transmission
}
// OLED set vertical shift
void OLED_shift(uint8_t ypos) {
	i2c_start();
	i2c_write(OLED_ADDR);                   // start transmission to OLED
	i2c_write(OLED_CMD_MODE);               // set command mode
	i2c_write(0xD3);                        // vertical shift command
	i2c_write(ypos);                        // set vertical shift value
	i2c_stop();                             // stop transmission
}
 //OLED print a number in array
 void OLED_printnum(uint8_t so)
 {
	 i2c_start();
	 i2c_write(OLED_ADDR);					// start transmission to OLED
	 i2c_write(OLED_DAT_MODE);
	 uint16_t offset = so + 15;					
	 offset += offset << 2;					// -> offset = so * 5
	 i2c_write(0x00);                       // print spacing between characters
	 for(uint8_t i=5; i; i--) i2c_write(pgm_read_byte(&OLED_FONT[offset++])); // print character
	 i2c_stop();
 }
// OLED set the cursor
void OLED_cursor(uint8_t xpos, uint8_t ypos) {
	i2c_start();
	i2c_write(OLED_ADDR);                   // start transmission to OLED
	i2c_write(OLED_CMD_MODE);               // set command mode
	i2c_write(xpos & 0x0F);                 // set low nibble of start column
	i2c_write(0x10 | (xpos >> 4));          // set high nibble of start column
	i2c_write(0xB0 | (ypos & 0x07));        // set start page
	i2c_stop();                             // stop transmission
}
// OLED clear screen
void OLED_clear(void) {
	OLED_cursor(0, 0);                      // set cursor at upper left corner
	i2c_start();
	i2c_write(OLED_ADDR);                   // start transmission to OLED
	i2c_write(OLED_DAT_MODE);               // set data mode
	for(uint16_t i=512; i; i--) i2c_write(0x00); // clear the screen
	i2c_stop();                            // stop transmission
	OLED_shift(0);                          // reset vertical shift
}
// OLED print a character
void OLED_printC(char ch) {
	uint16_t offset = ch - 32;              // calculate position of character in font array
	offset += offset << 2;                  // -> offset = (ch - 32) * 5
	i2c_write(0x00);                        // print spacing between characters
	for(uint8_t i=5; i; i--) i2c_write(pgm_read_byte(&OLED_FONT[offset++])); // print character
}

// OLED print a string from program memory
void OLED_printP(const char* p) {
	i2c_start();
	i2c_write(OLED_ADDR);                   // start transmission to OLED
	i2c_write(OLED_DAT_MODE);               // set data mode
	char ch = pgm_read_byte(p);             // read first character from program memory
	while (ch != 0) {                       // repeat until string terminator
		OLED_printC(ch);                      // print character on OLED
		ch = pgm_read_byte(++p);              // read next character
	}
	i2c_stop();                             // stop transmission
}
const char Message1[] PROGMEM = "CHUNG!";
int main(void)
{
	OLED_init();                            // initialize the OLED
	OLED_clear();                         // clear screen
    while (1) 
    {	 
		OLED_printnum(9); 
		OLED_printnum(7);
		OLED_printnum(6);
		OLED_printnum(5);
		 _delay_ms(1000);                      // wait a second
		OLED_printP(Message1);
    }
}